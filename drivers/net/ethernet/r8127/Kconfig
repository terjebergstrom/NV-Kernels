## drivers/net/ethernet/r8127/Kconfig
```kconfig
# SPDX-License-Identifier: GPL-2.0-only
#
# R8127 device configuration
#

config R8127
	tristate "RealTek RTL-8127 PCI Fast Ethernet Adapter support"
	depends on PCI
	help
	  This is a driver for the Fast Ethernet PCI network cards based on
	  the RTL8127 chips. If you have one of those, say Y here.

	  To compile this driver as a module, choose M here: the module
	  will be called 8127.  This is recommended.
```
